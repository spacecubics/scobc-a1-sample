## Kconfig
```kconfig
# Copyright (c) 2025 Space Cubics Inc.
# SPDX-License-Identifier: Apache-2.0

rsource "drivers/misc/sc_fpga/Kconfig"
rsource "drivers/i2c/Kconfig"
rsource "drivers/can/Kconfig"
```

## boards/shields/scobc_a1_dev/Kconfig.shield
```kconfig
# Copyright (c) 2025 Space Cubics Inc.
# SPDX-License-Identifier: Apache-2.0

config SHIELD_SCOBC_A1_DEV
	def_bool $(shields_list_contains,scobc_a1_dev)
```

## boards/shields/scobc_a1_devkit/Kconfig.shield
```kconfig
# Copyright (c) 2025 Space Cubics, LLC.
# SPDX-License-Identifier: Apache-2.0

config SHIELD_SCOBC_A1_DEVKIT
	def_bool $(shields_list_contains,scobc_a1_devkit)
```

## drivers/can/Kconfig
```kconfig
# Copyright (c) 2025 Space Cubics Inc.
# SPDX-License-Identifier: Apache-2.0

if CAN

rsource "Kconfig.sccan"

endif
```

## drivers/can/Kconfig.sccan
```kconfig
# Copyright (c) 2025 Space Cubics Inc.
# SPDX-License-Identifier: Apache-2.0

menuconfig CAN_SCCAN
	bool "Space Cubics CAN Driver"
	default y
	depends on DT_HAS_SC_CAN_ENABLED
	help
	  Enable Space Cubics CAN Driver.
```

## drivers/flash/Kconfig
```kconfig
# Copyright (c) 2025 Space Cubics Inc.
# SPDX-License-Identifier: Apache-2.0

if FLASH

rsource "Kconfig.sc"

endif
```

## drivers/i2c/Kconfig
```kconfig
# Copyright (c) 2025 Space Cubics Inc.
# SPDX-License-Identifier: Apache-2.0

if I2C

rsource "Kconfig.sc"

endif
```

## drivers/misc/sc_fpga/Kconfig
```kconfig
# Copyright (c) 2025 Space Cubics Inc.
# SPDX-License-Identifier: Apache-2.0

rsource "Kconfig.sysmon"
```

## drivers/misc/sc_fpga/Kconfig.sysmon
```kconfig
# Copyright (c) 2025 Space Cubics Inc.
# SPDX-License-Identifier: Apache-2.0

menuconfig SC_SYSMON
	bool "Space Cubics System Monitor driver"
	default y
	depends on DT_HAS_SC_SYSMON_ENABLED
	help
	  Enable Space Cubics System Monitor driver.

if SC_SYSMON

config SC_SYSMON_INIT_PRIORITY
	int "Init priority"
	default 50
	help
	   Space Cubics System Monitor driver initialization priority.

module = SC_SYSMON
module-str = Space Cubics System Monitor driver
source "subsys/logging/Kconfig.template.log_config"

endif
```

## west.yml
```yaml
manifest:

  projects:
    - name: zephyr
      url: https://github.com/spacecubics/zephyr.git
      revision: support-west-flash-to-nor
      path: zephyr
      west-commands: scripts/west-commands.yml
      import:
        name-allowlist:
          - cmsis
          - cmsis_6
          - littlefs

    - name: openocd
      url: https://github.com/spacecubics/openocd.git
      revision: release-scobc-a1-openocd
      path: modules/tools/openocd
```

## zephyr/dts/bindings/flash_controller/sc,qspi-nor-a1.yaml
```yaml
# Copyright (c) 2025 Space Cubics Inc.
# SPDX-License-Identifier: Apache-2.0

description: |
    Space Cubics SC-OBC Module A1 QSPI NOR Flash Controller

    Representation of a serial flash on a quadspi bus:

        qspi: qspi@40100000 {
            compatible = "sc,qspi-a1";
            reg = <0x40100000 0x1000>;
            interrupts = <3 0>;
            cpol = <0>;
            cpha = <0>;
            spiclk-div = <0>;
            status = "okay";

            data_flash0: flash0 {
                compatible = "sc,qspi-nor-a1";
                mem-no = <0>;
                size = <DT_SIZE_M(32)>;
                jedec-id = [01 60 19];
                status = "okay";
            };
        };

compatible: "sc,qspi-nor-a1"

include: ["jedec,jesd216.yaml"]

on-bus: qspi

properties:
  mem-no:
    type: int
    description: NOR Flash memory number (0 or 1).
    required: true

  size:
    description: Flash Memory size in octets
    required: true

  jedec-id:
    type: uint8-array
    description: 3-byte JEDEC ID of the NOR flash
    required: true

  sc-sysreg:
    type: phandle
    description: |
      Reference to the system register node (sysreg).
      Required if configuration memory, it's used to handle memory selection.
```

## zephyr/dts/bindings/i2c/sc,i2c.yaml
```yaml
# Copyright (c) 2025 Space Cubics Inc.
# SPDX-License-Identifier: Apache-2.0

description: SC-OBC Module A1 I2C Master controller

compatible: "sc,i2c"

include: [i2c-controller.yaml]

properties:
  reg:
    required: true

  interrupts:
    required: true
```

## zephyr/dts/bindings/qspi/sc,qspi-a1.yaml
```yaml
# Copyright (c) 2025 Space Cubics Inc.
# SPDX-License-Identifier: Apache-2.0

description: Space Cubics SC-OBC Module A1 QSPI Controller

compatible: "sc,qspi-a1"

include: base.yaml

properties:
  reg:
    description: QSPI controller register base address and size
    required: true

  interrupts:
    description: QSPI interrupt specifier (IRQ, priority)
    required: true

  cpol:
    type: int
    description: Clock Polarity in SPI
    required: true

  cpha:
    type: int
    description: Clock Phase in SPI
    required: true

  spiclk-div:
    type: int
    description: Clock divider for the SPI clock relative to the system clock
    required: true

bus: qspi
```
